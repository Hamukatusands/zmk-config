#include "chalk_01.dtsi"

&kscan0 {
    row-gpios
        = <&xiao_d 6 (GPIO_ACTIVE_HIGH | GPIO_PULL_DOWN)> // row1
        , <&xiao_d 2 (GPIO_ACTIVE_HIGH | GPIO_PULL_DOWN)> // row2
        , <&xiao_d 7 (GPIO_ACTIVE_HIGH | GPIO_PULL_DOWN)> // row3
        , <&xiao_d 4 (GPIO_ACTIVE_HIGH | GPIO_PULL_DOWN)> // row4
        ;

    col-gpios
        = <&xiao_d 10 GPIO_ACTIVE_HIGH> // col6（左端・小指側）
        , <&xiao_d 9  GPIO_ACTIVE_HIGH> // col5
        , <&xiao_d 8  GPIO_ACTIVE_HIGH> // col4
        , <&xiao_d 1  GPIO_ACTIVE_HIGH> // col3
        , <&xiao_d 3  GPIO_ACTIVE_HIGH> // col2
        , <&xiao_d 5  GPIO_ACTIVE_HIGH> // col1（右端・人差し指側）
        ;
};