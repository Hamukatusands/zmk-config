## boards/shields/chalk_01/Kconfig.shield
```kconfig
config SHIELD_CHALK_01_LEFT
    def_bool $(shields_list_contains,chalk_01_left)

config SHIELD_CHALK_01_RIGHT
    def_bool $(shields_list_contains,chalk_01_right)
```
